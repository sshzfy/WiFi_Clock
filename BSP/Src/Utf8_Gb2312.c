/* ============================================================
 * UTF-8 -> GB2312 转码 (仅 ASCII + GB2312 一级汉字)
 * ------------------------------------------------------------
 * 本文件由 Documents/Tools/gen_gb2312_table.py 生成, 请勿手工修改数值。
 *
 * 为什么需要它:
 *   LCD 的汉字字模 (W25Q64 里的 cn16.bin / cn22.bin) 按 GB2312 区位码
 *   索引, 而高德 / 心知天气等接口返回的是 UTF-8。直接把 UTF-8 中文丢给
 *   ST7789_Write_String() 会查不到字模, 显示为空白。
 *
 * 表的范围:
 *   只覆盖 GB2312 一级汉字 3755 字 (区码 0xB0~0xD7), 与字库完全一致;
 *   二级汉字本来就没有字模, 转出来也只能显示空白, 这里直接丢弃该字符
 *   (不占宽度, 不会破坏后面的排版)。
 *   表按 Unicode 升序排列, 转换时二分查找, 无额外 RAM 开销。
 * ============================================================ */

#include "Utf8_Gb2312.h"

#define GB_TABLE_COUNT 3755U /* 一级汉字数量, 与 ASSET_GLYPH_COUNT 一致 */

/* Unicode 码点(升序) —— 二分查找的键 */
static const uint16_t Uni_Table[GB_TABLE_COUNT] = {
    0x4E00U, 0x4E01U, 0x4E03U, 0x4E07U, 0x4E08U, 0x4E09U, 0x4E0AU, 0x4E0BU,
    0x4E0DU, 0x4E0EU, 0x4E11U, 0x4E13U, 0x4E14U, 0x4E16U, 0x4E18U, 0x4E19U,
    0x4E1AU, 0x4E1BU, 0x4E1CU, 0x4E1DU, 0x4E22U, 0x4E24U, 0x4E25U, 0x4E27U,
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    0x9F99U, 0x9F9AU, 0x9F9FU,
};

/* 与 Uni_Table 一一对应的 GB2312 双字节码(高字节在前) */
static const uint16_t Gb_Table[GB_TABLE_COUNT] = {
    0xD2BBU, 0xB6A1U, 0xC6DFU, 0xCDF2U, 0xD5C9U, 0xC8FDU, 0xC9CFU, 0xCFC2U,
    0xB2BBU, 0xD3EBU, 0xB3F3U, 0xD7A8U, 0xC7D2U, 0xCAC0U, 0xC7F0U, 0xB1FBU,
    0xD2B5U, 0xB4D4U, 0xB6ABU, 0xCBBFU, 0xB6AAU, 0xC1BDU, 0xD1CFU, 0xC9A5U,
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    0xC1FAU, 0xB9A8U, 0xB9EAU,
};

/**
 * @brief 在对照表里二分查找 Unicode 码点对应的 GB2312 码
 * @param uni Unicode 码点(基本多文种平面)
 * @return GB2312 双字节码(高字节<<8 | 低字节); 0 = 一级字库没有该字
 */
static uint16_t Utf8_Find_Gb(uint16_t uni)
{
    /* 用有符号 int 做下标: mid=0 时 mid-1 必须变成 -1 结束循环,
     * 若用 uint16_t 会回绕成 65535, 接着就会越界访问整张表 */
    int lo = 0;
    int hi = (int)GB_TABLE_COUNT - 1;

    while (lo <= hi)
    {
        int mid = (lo + hi) / 2;

        if (Uni_Table[mid] < uni)
            lo = mid + 1;
        else if (Uni_Table[mid] > uni)
            hi = mid - 1;
        else
            return Gb_Table[mid];
    }

    return 0U;
}

/**
 * @brief 把 UTF-8 字符串转成 GB2312(一级汉字) + ASCII 混合串
 * @param src      UTF-8 源串(NULL 视为空串)
 * @param dst      输出缓冲
 * @param dst_size 输出缓冲字节数(含结尾 '\0')
 * @return 写入 dst 的字节数(不含结尾 '\0')
 * @note  放不下的字符整字丢弃; 查不到字模的汉字整字跳过, 因此返回长度
 *        可能短于源串, 但仍保证 dst 是合法的 GB2312 串。
 */
uint16_t Utf8_To_Gb2312(const char *src, char *dst, uint16_t dst_size)
{
    const uint8_t *p = (const uint8_t *)src;
    uint16_t n = 0U;

    if (dst == NULL || dst_size == 0U)
        return 0U;

    dst[0] = '\0';

    if (src == NULL)
        return 0U;

    while (*p != 0U)
    {
        uint16_t uni;
        uint16_t gb;

        /* ASCII: 原样拷贝(液晶 ASCII 字模宽度 = 汉字的一半) */
        if (*p < 0x80U)
        {
            if ((uint16_t)(n + 1U) >= dst_size)
                break;
            dst[n++] = (char)(*p++);
            continue;
        }

        if ((*p & 0xF0U) == 0xE0U) /* 3 字节序列: 汉字就在这一段 */
        {
            if (p[1] == 0U || p[2] == 0U)
                break; /* 序列被截断, 后面的内容不可信 */
            uni = (uint16_t)(((uint16_t)(p[0] & 0x0FU) << 12) |
                             ((uint16_t)(p[1] & 0x3FU) << 6) |
                             (uint16_t)(p[2] & 0x3FU));
            p += 3;
        }
        else if ((*p & 0xE0U) == 0xC0U) /* 2 字节序列(拉丁扩展等): 丢弃 */
        {
            if (p[1] == 0U)
                break;
            p += 2;
            continue;
        }
        else /* 4 字节序列或非法首字节: 丢弃 */
        {
            p++;
            continue;
        }

        gb = Utf8_Find_Gb(uni);
        if (gb == 0U)
            continue; /* 一级字库没有这个字: 整字跳过 */

        if ((uint16_t)(n + 2U) >= dst_size)
            break;
        dst[n++] = (char)(gb >> 8);
        dst[n++] = (char)(gb & 0xFFU);
    }

    dst[n] = '\0';

    return n;
}

/**
 * @brief 按像素宽度截断 GB2312 串(汉字 = font_size, ASCII = font_size/2)
 * @param gb        GB2312 串(就地截断)
 * @param max_px    可用像素宽度
 * @param font_size 字号(像素高)
 * @return None
 * @note  只会在字符边界上截断, 不会留下半个汉字。
 */
void Gb2312_Truncate_Px(char *gb, uint16_t max_px, uint16_t font_size)
{
    uint16_t n = 0U;
    uint16_t px = 0U;

    if (gb == NULL || font_size == 0U)
        return;

    while (gb[n] != '\0')
    {
        uint8_t ch = (uint8_t)gb[n];
        uint16_t w;

        if (ch >= 0xA1U && ch <= 0xF7U) /* 汉字: 两个字节一个字 */
        {
            if (gb[n + 1] == '\0')
                break; /* 只有半个汉字, 丢弃 */
            w = font_size;
            if ((uint16_t)(px + w) > max_px)
                break;
            n = (uint16_t)(n + 2U);
        }
        else /* ASCII: 一个字节半个字宽 */
        {
            w = (uint16_t)(font_size / 2U);
            if ((uint16_t)(px + w) > max_px)
                break;
            n++;
        }

        px = (uint16_t)(px + w);
    }

    gb[n] = '\0';
}
